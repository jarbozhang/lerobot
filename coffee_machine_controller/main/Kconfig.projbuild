## coffee_machine_controller/main/Kconfig.projbuild
```kconfig
menu "Controller Configuration"

    orsource "$IDF_PATH/examples/common_components/env_caps/$IDF_TARGET/Kconfig.env_caps"

    config CONTROLLER_UART_PORT_NUM
        int "UART port number"
        range 0 2 if IDF_TARGET_ESP32 || IDF_TARGET_ESP32S3
        default 2 if IDF_TARGET_ESP32 || IDF_TARGET_ESP32S3
        range 0 1
        default 1
        help
            UART communication port number.

    config CONTROLLER_UART_BAUD_RATE
        int "UART baud rate"
        range 1200 115200
        default 115200
        help
            UART communication baud rate.

    config CONTROLLER_UART_RXD
        int "UART RXD pin"
        range ENV_GPIO_RANGE_MIN ENV_GPIO_IN_RANGE_MAX
        default 19
        help
            GPIO number for UART RX pin.

    config CONTROLLER_UART_TXD
        int "UART TXD pin"
        range ENV_GPIO_RANGE_MIN ENV_GPIO_OUT_RANGE_MAX
        default 20
        help
            GPIO number for UART TX pin.

    config CONTROLLER_TASK_STACK_SIZE
        int "Task stack size"
        range 1024 16384
        default 3072
        help
            Stack size for controller tasks.

endmenu

menu "ESP-NOW Configuration"

    choice ESPNOW_WIFI_MODE
        prompt "WiFi mode"
        default ESPNOW_WIFI_MODE_STATION
        help
            WiFi mode (station or softap).

        config ESPNOW_WIFI_MODE_STATION
            bool "Station"
        config ESPNOW_WIFI_MODE_SOFTAP
            bool "Softap"
    endchoice

    config ESPNOW_PMK
        string "ESPNOW primary master key"
        default "pmk1234567890123"
        help
            ESPNOW primary master key. Must be 16 bytes.

    config ESPNOW_LMK
        string "ESPNOW local master key"
        default "lmk1234567890123"
        help
            ESPNOW local master key. Must be 16 bytes.

    config ESPNOW_CHANNEL
        int "Channel"
        default 1
        range 1 14
        help
            WiFi channel for ESP-NOW communication.

    config ESPNOW_SEND_COUNT
        int "Send count"
        default 100
        range 1 65535
        help
            Total count of unicast data to send.

    config ESPNOW_SEND_DELAY
        int "Send delay (ms)"
        default 1000
        range 0 65535
        help
            Delay between sending two ESP-NOW packets, in milliseconds.

    config ESPNOW_SEND_LEN
        int "Send length"
        range 10 250
        default 200
        help
            Length of ESP-NOW data to send, in bytes.

    config ESPNOW_ENABLE_LONG_RANGE
        bool "Enable Long Range"
        default n
        help
            Enable long range mode for ESP32.

    config ESPNOW_ENABLE_POWER_SAVE
        bool "Enable Power Save"
        default n
        select ESP_WIFI_STA_DISCONNECTED_PM_ENABLE
        depends on ESPNOW_WIFI_MODE_STATION
        help
            Enable ESP-NOW power save mode.

    config ESPNOW_WAKE_WINDOW
        int "Wake window (ms)"
        range 0 65535
        default 50
        depends on ESPNOW_ENABLE_POWER_SAVE
        help
            ESP-NOW wake window in milliseconds.

    config ESPNOW_WAKE_INTERVAL
        int "Wake interval (ms)"
        range 1 65535
        default 100
        depends on ESPNOW_ENABLE_POWER_SAVE
        help
            ESP-NOW wake interval in milliseconds.

endmenu
```
